## thingino_port/configs/cameras/teckin_tc100_ak3918ev300_jxf23_rtl8188fu/teckin_tc100_ak3918ev300_jxf23_rtl8188fu_defconfig
```kconfig
# NAME: TECKIN TC100 (AK3918EV300, JX-F23, RTL8188FU)
# FRAG: soc-arm926ejs core
BR2_SOC_VENDOR_ANYKA=y
BR2_ANYKA_SOC_MODEL="ak3918ev300"
BR2_PACKAGE_WIFI=y
BR2_PACKAGE_WIFI_RTL8188FU=y
BR2_SENSOR_1_NAME="jxf23"
BR2_SENSOR_1_PARAMS="shvflip=1"
BR2_THINGINO_AUDIO=y
BR2_THINGINO_BUTTON=y
BR2_THINGINO_LED_B_GPIO=25
BR2_THINGINO_LED_R_GPIO=26
BR2_THINGINO_SDCARD=y
FLASH_SIZE_MB=8
```

## v3/buildroot/package/tc100-whep/Config.in
```kconfig
config BR2_PACKAGE_TC100_WHEP
	bool "tc100-whep"
	depends on BR2_PACKAGE_MBEDTLS
	help
	  WebRTC (WHEP) gateway of the TC100 camera (src/whep of this
	  source tree, item 35): ICE-lite, DTLS-SRTP with mbedTLS and SRTP,
	  fed with RTP from tc100_rtsp. The service starts at boot by default
	  (WHEP=1 in boot.conf); set WHEP=0 to disable it.
```
